#define ZMK_MOUSE_DEFAULT_MOVE_VAL 1000  // 600
#define ZMK_MOUSE_DEFAULT_SCRL_VAL 20    // 10

#include <dt-bindings/zmk/mouse.h>
#include <behaviors/mouse_keys.dtsi>

&mmv {
    acceleration-exponent = <1>;      // 1
    time-to-max-speed-ms = <800>;     // 300
    delay-ms = <50>;                   // 0
};

&msc {
    acceleration-exponent = <1>;      // 0
    time-to-max-speed-ms = <40>;      // 300
    delay-ms = <0>;                   // 0
};
